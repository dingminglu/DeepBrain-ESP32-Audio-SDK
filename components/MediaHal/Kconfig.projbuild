## components/MediaHal/Kconfig.projbuild
```kconfig
menu "Audio Media HAL"

choice AUDIO_BOARD
    prompt "Audio hardware board"
    default ESP_LYRAT_V4_3_BOARD
    help
        Select an audio board to use with the ESP-ADF

config ESP_DEEPBRAIN_V1_0_BOARD
    bool "ESP32-DEEPBRAIN V1.0"
config ESP_LYRAT_V4_3_BOARD
    bool "ESP32-Lyrat V4.3"
config ESP_LYRAT_V4_2_BOARD
    bool "ESP32-Lyrat V4.2"
config ESP_LYRATD_MSC_V2_1_BOARD
    bool "ESP32-LyraTD-MSC V2.1"
config ESP_LYRATD_MSC_V2_2_BOARD
    bool "ESP32-LyraTD-MSC V2.2"
config ESP_LYRATD_FT_V1_0_BOARD
    bool "ESP32-LyraTD-FT V1.0"
config ESP_LYRATD_FT_DOSS_V1_0_BOARD
    bool "ESP32-LyraTD-FT DOSS V1.0"
config ESP_LYRATD_KN_V1_0_BOARD
    bool "ESP32-LyraTD-KN V1.0"
endchoice

choice AUDIO_CODEC_CHIP
    prompt "Audio codec chip"
    default CODEC_CHIP_IS_ES8388
    help
        Select an audio codec to use with the project

config CODEC_CHIP_IS_ES8388
    bool "CODEC IS ES8388"
    depends on ESP_LYRAT_V4_3_BOARD || ESP_LYRAT_V4_2_BOARD || ESP_DEEPBRAIN_V1_0_BOARD
config CODEC_CHIP_IS_ES7149
    bool "CODEC IS ES7149"
    depends on ESP_LYRATD_FT_V1_0_BOARD || ESP_LYRATD_FT_DOSS_V1_0_BOARD
config CODEC_CHIP_IS_MICROSEMI
    bool "DAC IS MICROSEMI"
    depends on ESP_LYRATD_MSC_V2_1_BOARD || ESP_LYRATD_MSC_V2_2_BOARD
config CODEC_CHIP_IS_ES8374
    bool "CODEC IS ES8374"
endchoice



endmenu
```

## components/recorder_engine/Kconfig.projbuild
```kconfig
menu "Speech Recognition Configuration"

choice Speech_Recognition_Engine
    prompt "Speech Recognition Engine"
    default SR_TYPE_ESPRESSIF
    help
        Select speech recognition engine

config SR_TYPE_ESPRESSIF
    bool "Espressif wakeup engine"

config SR_TYPE_SNOWBOY
    bool "Snowboy wakeup engine"
endchoice


choice Name_Of_Wakeup_Word
    prompt "Name Of Wakeup Word"
    default WAKEUP_WORD_NAME_HI_LEXIN
    help
        Select wakeup word

config WAKEUP_WORD_NAME_XIAODU
    bool "Wakeup word is XiaoDu XiaoDu"

config WAKEUP_WORD_NAME_HI_LEXIN
    bool "Wakeup word is Hi Lexin"
    depends on SR_TYPE_ESPRESSIF

config WAKEUP_WORD_NAME_ALEXA
    bool "Wakeup word is Alexa"
    depends on SR_TYPE_ESPRESSIF

config WAKEUP_WORD_NAME_HAOGE
    bool "Wakeup word is HaoGe HaoGe"
    depends on SR_TYPE_ESPRESSIF

endchoice

endmenu
```

## components/userconfig/Kconfig.projbuild
```kconfig
menu "ESP Audio App"

config ENABLE_OTA_SERVICE
    bool "Enable the OTA service"
    default n
    help
        Enable ota service, it will need wifi enable.

config ENABLE_DLNA_SERVICE
    bool "Enable the DLNA service"
    default y
    help
        Enable DLNA service.

config ENABLE_DUEROS_SERVICE
    bool "Enable the DuerOS service"
    default n
    help
        Enable DuerOS service.

config ENABLE_TURINGAIWIFI_SERVICE
    bool "Enable the turingaiwifi service"
    default n
    help
        Enable turingaiwifi service.

config ENABLE_TURING_WAKEUP
    bool "Enable near field wakeup"
    default n
    depends on ENABLE_TURINGAIWIFI_SERVICE
    help
       enable near field wakeup function for turing AIWIFI service

config ENABLE_TURINGWECHAT_SERVICE
    bool "Enable the turingwechat service"
    default n
    help
        Enable turingwechat service.

config ENABLE_SMART_CONFIG
    bool "Enable the smart config method"
    default n
    help
        Enable smart config.


config ENABLE_BLE_CONFIG
    bool "Enable the ble config method"
    depends on BLUEDROID_ENABLED
    default n
    help
        Enable ble config.

config ESP_AUDIO_WIFI_SSID
    string "WI-FI SSID"
    default "Your SSID"
    help
        Add WIFI SSID.
config ESP_AUDIO_WIFI_PWD
    string "WI-FI password"
    default "Your password"
    help
        Add WIFI password.

endmenu
```
